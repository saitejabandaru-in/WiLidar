## hardware/esp32s3/sdkconfig.defaults
```kconfig
# Pre-configured settings to enable WiFi CSI and optimize stack size / performance in ESP-IDF v5.3+

# Enable WiFi CSI (mandatory)
CONFIG_ESP_WIFI_CSI_ENABLED=y

# Disable AMPDU RX which breaks CSI phase coherence (Pitfall 1 & Phase Sanitization prerequisite)
CONFIG_ESP_WIFI_AMPDU_RX_ENABLED=n

# Increase static and dynamic buffers to prevent packet dropping / queue overflows (Pitfall 2 & 10)
CONFIG_ESP_WIFI_STATIC_RX_BUFFER_NUM=16
CONFIG_ESP_WIFI_DYNAMIC_RX_BUFFER_NUM=32

# Set lost IP timer to 0 to prevent reconnect delays, keeping STA mode responsive
CONFIG_LWIP_IP_LOST_TIMER_INTERVAL=0

# Configure compiler optimization for speed (real-time filtering needs efficiency)
CONFIG_COMPILER_OPTIMIZATION_PERF=y

# FreeRTOS setup: enable multi-core task scheduling
CONFIG_FREERTOS_UNICORE=n
```
